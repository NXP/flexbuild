## configs/linux/linux_arm64_LS_signature.its
```
/*
 * Copyright 2017 - 2020 NXP
 *
 */


/dts-v1/;

/ {
	description = "arm64 kernel, ramdisk and FDT blob";
	#address-cells = <1>;

	images {
		kernel {
			description = "ARM64 Kernel";
			data = /incbin/("../../build/linux/kernel/arm64/LS/Image.gz");
			type = "kernel";
			arch = "arm64";
			os = "linux";
			compression = "gzip";
			load = <0x84080000>;
			entry = <0x84080000>;
			hash {
				algo = "sha1";
			};
			signature {
				algo = "sha1,rsa2048";
				key-name-hint = "dev";
			};
		};

		initrd {
			description = "initrd for arm64";
			data = /incbin/("../../build/images/rootfs_yocto_arm64_tiny.cpio.gz");
			type = "ramdisk";
			arch = "arm64";
			os = "linux";
			compression = "none";
			load = <0x00000000>;
			entry = <0x00000000>;
			hash {
				algo = "sha1";
			};
			signature {
				algo = "sha1,rsa2048";
				key-name-hint = "dev";
			};
		};

                ls1028ardb-dtb {
                        description = "ls1028ardb-dtb";
                        data = /incbin/("../../build/linux/kernel/arm64/LS/fsl-ls1028a-rdb.dtb");
                        type = "flat_dt";
                        arch = "arm64";
                        os = "linux";
                        compression = "none";
                        load = <0x90000000>;
                        hash {
                                algo = "sha1";
                        };
                        signature {
                                algo = "sha1,rsa2048";
                                key-name-hint = "dev";
                        };
                };

                ls1043ardb-dtb {
                        description = "ls1043ardb-dtb";
                        data = /incbin/("../../build/linux/kernel/arm64/LS/fsl-ls1043a-rdb-sdk.dtb");
                        type = "flat_dt";
                        arch = "arm64";
                        os = "linux";
                        compression = "none";
                        load = <0x90000000>;
                        hash {
                                algo = "sha1";
                        };
                        signature {
                                algo = "sha1,rsa2048";
                                key-name-hint = "dev";
                        };
                };

                lx2160ardb-dtb {
                        description = "lx2160ardb-dtb";
                        data = /incbin/("../../build/linux/kernel/arm64/LS/fsl-lx2160a-rdb.dtb");
                        type = "flat_dt";
                        arch = "arm64";
                        os = "linux";
                        compression = "none";
                        load = <0x90000000>;
                        hash {
                                algo = "sha1";
                        };
                        signature {
                                algo = "sha1,rsa2048";
                                key-name-hint = "dev";
                        };
                };

		lx2162aqds-dtb {
			description = "lx2162aqds-dtb";
			data = /incbin/("../../build/linux/kernel/arm64/LS/fsl-lx2162a-qds.dtb");
			type = "flat_dt";
			arch = "arm64";
			os = "linux";
			compression = "none";
			load = <0x90000000>;
			hash {
				algo = "sha1";
			};
			signature {
				algo = "sha1,rsa2048";
				key-name-hint = "dev";
			};
		};
	};

	configurations {
		ls1028ardb {
			description = "config for ls1028ardb";
			kernel = "kernel";
			ramdisk = "initrd";
			fdt = "ls1028ardb-dtb";
			signature {
				algo = "sha1,rsa2048";
				key-name-hint = "dev";
				sign-images = "kernel", "fdt","ramdisk";
			};
		};

		ls1043ardb {
			description = "config for ls1043ardb";
			kernel = "kernel";
			ramdisk = "initrd";
			fdt = "ls1043ardb-dtb";
			signature {
				algo = "sha1,rsa2048";
				key-name-hint = "dev";
				sign-images = "kernel", "fdt","ramdisk";
			};
		};
	
                lx2160ardb {
                        description = "config for lx2160ardb";
                        kernel = "kernel";
                        ramdisk = "initrd";
                        fdt = "lx2160ardb-dtb";
                        signature {
                                algo = "sha1,rsa2048";
                                key-name-hint = "dev";
                                sign-images = "kernel", "fdt","ramdisk";
                        };
                };


		lx2162aqds {
			description = "config for lx2162aqds";
			kernel = "kernel";
			ramdisk = "initrd";
			fdt = "lx2162aqds-dtb";
			signature {
				algo = "sha1,rsa2048";
				key-name-hint = "dev";
				sign-images = "kernel", "fdt","ramdisk";
			};
		};
	};
};
```

## src/apps/Kconfig
```kconfig
source "src/apps/graphics/Kconfig"

source "src/apps/multimedia/Kconfig"

source "src/apps/ml/Kconfig"

source "src/apps/gopoint/Kconfig"

source "src/apps/networking/Kconfig"

source "src/apps/utils/Kconfig"

source "src/apps/security/Kconfig"

source "src/apps/robotics/Kconfig"
```

## src/apps/gopoint/Kconfig
```kconfig
# ============================================================================
# GoPoint Demo Configuration
# ============================================================================

config APP_GOPOINT
	bool "GoPoint demo applications"
	default y
	depends on PLATFORM_IMX
	help
	  Build GoPoint demo applications

if APP_GOPOINT && PLATFORM_IMX

config GP_GTEC_DEMO_FRAMEWORK
	bool "Gtec demo framework"
	default y
	depends on (SOC_IMX8M  && GFX_GPU_VIV) || \
               (SOC_IMX95 && GFX_MALI_IMX)
	help
	  Gtec demo framework for creating graphical demos

config GP_IMX_DEMO_EXPERIENCE
	bool "i.MX Demo Experience application"
	default y
	help
	  i.MX Demo Experience showcase application

config GP_IMX_DEMOS_LIST
	bool "i.MX demos list manager"
	default y
	depends on GP_IMX_DEMO_EXPERIENCE
	help
	  Demo list manager for i.MX platforms

config GP_IMX_EBIKE_VIT
	bool "i.MX E-bike VIT demo"
	default y
	depends on SOC_IMX8 || SOC_IMX95 || SOC_IMX93
	#depends on GP_NXP_AFE
	#depends on GP_IMX_VOICEUI
	help
	  E-bike demo with Voice Intelligence Technology

config GP_IMX_ELE
	bool "i.MX EdgeLock Enclave demo"
	default y
	depends on SOC_IMX93 && SEC_IMX_SECURE_ENCLAVE
	help
	  i.MX EdgeLock Enclave demonstration

config GP_IMX_NNSTREAMER_EXAMPLES
	bool "i.MX NNStreamer examples"
	default y
	depends on ML_NNSTREAMER && ML_TFLITE && MM_GST_PLUGINS_GOOD && MM_GSTREAMER
	help
	  NNStreamer examples for i.MX platforms

config GP_IMX_SMART_FITNESS
	bool "i.MX Smart Fitness demo"
	default y
	depends on (SOC_IMX93 || SOC_IMX8M) && ML_TFLITE && ML_NNSTREAMER
	help
	  Smart fitness tracking demonstration

config GP_IMX_SMART_KITCHEN
	bool "i.MX Smart Kitchen demo"
	default y
	depends on SOC_IMX8M || SOC_IMX95 || SOC_IMX93
	#depends on GP_IMX_VOICEUI
	help
	  Smart kitchen assistant demonstration

config GP_IMX_CAMERA_ROTATION
	bool "i.MX Camera Rotation"
	default y
	depends on (SOC_IMX8M || SOC_IMX95) && \
               (!SOC_IMX8M || (GFX_IMX_GPU_G2D && GFX_GPU_VIV)) && \
               (!SOC_IMX95 || (GFX_IMX_DPU_G2D_V2 && GFX_MALI_IMX))
	help
	  Camera frame rotation support

#config GP_IMX_VIDEO2TEXTURE
#	bool
#	#bool "i.MX Video to Texture demo"
#	default y
#	depends on MM_GSTREAMER
#	depends on MM_GST_PLUGINS_GOOD
#	help
#	  Video to texture rendering demonstration

#config GP_IMX_VOICEPLAYER
#	bool
#	#bool "i.MX Voice Player"
#	default y
#	depends on GP_IMX_VOICEUI
#	depends on MM_ALSA_LIB
#	help
#	  Voice-controlled audio player

#config GP_IMX_VOICEUI
#	bool
#	#bool "i.MX Voice UI framework"
#	default y
#	#depends on GP_NXP_AFE
#	#depends on MM_ALSA_LIB
#	help
#	  Voice user interface framework

config GP_NXP_AFE
	bool "NXP Audio Front End"
	default y
	depends on MM_ALSA_LIB
	help
	  NXP Audio Front End for voice processing

#config GP_NXP_DEMO_EXPERIENCE_ASSETS
#	bool
#	#bool "NXP Demo Experience assets"
#	default y
#	help
#	  Media assets for NXP Demo Experience

endif # APP_GOPOINT && PLATFORM_IMX
```

## src/apps/graphics/Kconfig
```kconfig
# ============================================================================
# Graphics Configuration
# ============================================================================

config APP_GRAPHICS
	bool "Graphics applications"
	default y
	help
	  Build graphics applications (Wayland, Weston, GPU drivers, etc.)

if APP_GRAPHICS

if PLATFORM_IMX

config GFX_CLUTTER_GST
	bool "Clutter-GST integration library"
	default y
	depends on SOC_IMX8 || SOC_IMX95
	depends on MM_GST_PLUGINS_BAD && GFX_COGL && GFX_LIBDRM
	help
	  GStreamer integration library for Clutter

config GFX_COGL
	bool "Cogl 3D graphics API"
	default y
    depends on (SOC_IMX8 && GFX_GPU_VIV) || (SOC_IMX95 && GFX_MALI_IMX)
    depends on GFX_LIBDRM && GFX_WAYLAND_PROTOCOLS
	help
	  Modern 3D graphics API for Clutter

config GFX_GPUTOP
	bool "gputop GPU profiling tool"
	default y
	depends on SOC_IMX8 && GFX_LIBGPUPERFCNT
	help
	  GPU profiling tool for Intel graphics

config GFX_IMX_DPU_G2D_V1
	bool "i.MX DPU G2D V1 support"
	default y
	depends on SOC_IMX8QMMEK && GFX_LIBDRM
	help
	  i.MX Display Processing Unit 2D graphics acceleration

config GFX_IMX_DPU_G2D_V2
	bool "i.MX DPU G2D V2 support"
	default y
	depends on SOC_IMX95 && GFX_LIBDRM
	help
	  i.MX Display Processing Unit 2D graphics acceleration

config GFX_IMX_G2D_SAMPLES
	bool "i.MX G2D sample applications"
	default y
    depends on (SOC_IMX8 && GFX_IMX_GPU_G2D && GFX_GPU_VIV) || \
               ((SOC_IMX91 || SOC_IMX93) && GFX_IMX_PXP_G2D) || \
               (SOC_IMX8QMMEK && GFX_IMX_DPU_G2D_V1) || \
               (SOC_IMX95 && GFX_IMX_DPU_G2D_V2 && GFX_MALI_IMX)
	help
	  Sample applications for i.MX G2D API

config GFX_IMX_PXP_G2D
	bool "i.MX PXP G2D support"
	default y
	depends on GFX_LIBDRM && (SOC_IMX91 || SOC_IMX93)
	help
	  i.MX Pixel Pipeline 2D graphics acceleration

config GFX_LIBGPUPERFCNT
	bool "GPU performance counter library"
	default y
	depends on SOC_IMX8 && GFX_GPU_VIV
	help
	  Library for accessing GPU performance counters

config GFX_MALI_IMX
	bool "Mali GPU driver for i.MX"
	default y
	depends on SOC_IMX95 && GFX_LIBDRM
	help
	  ARM Mali GPU driver for i.MX platforms

#config GFX_VKMARK
#	bool "vkmark Vulkan benchmark"
#	default y
#	depends on GFX_VULKAN_HEADERS
#	depends on GFX_LIBDRM
#	help
#	  Vulkan benchmark suite

config GFX_VULKAN_HEADERS
	bool "Vulkan API headers"
	default y
	help
	  Vulkan graphics and compute API headers

#config GFX_APITRACE
#	bool "apitrace graphics debugging tool"
#	default y
#	help
#	  Tools for tracing OpenGL, Direct3D, and other graphics APIs

endif # PLATFORM_IMX

config GFX_GPU_VIV
	bool "Vivante GPU driver"
	default y
	depends on (SOC_IMX8 || SOC_LS1028ARDB) && GFX_LIBDRM
	help
	  Vivante GPU driver for i.MX platforms

config GFX_IMX_GPU_G2D
	bool "i.MX GPU 2D acceleration"
	default y if (PLATFORM_IMX || SOC_LS1028ARDB)
	depends on (SOC_IMX8 || SOC_LS1028ARDB) && GFX_GPU_VIV && GFX_LIBDRM
	help
	  i.MX GPU-based 2D graphics acceleration library

config GFX_LIBDRM
	bool "libdrm - Direct Rendering Manager library"
	default y
	depends on SOC_LS1028ARDB || PLATFORM_IMX
	help
	  Userspace library for accessing the Direct Rendering Manager

#config GFX_WAYLAND
#	bool "Wayland display server protocol"
#	default y
#	help
#	  Wayland compositor infrastructure

config GFX_WAYLAND_PROTOCOLS
	bool "Wayland protocols"
	default y
	depends on SOC_LS1028ARDB || PLATFORM_IMX
	help
	  Wayland protocol specifications

config GFX_WESTON
	bool "Weston reference compositor"
	default y
    depends on \
        (SOC_LS1028ARDB || PLATFORM_IMX) && \
        (GFX_WAYLAND_PROTOCOLS && GFX_LIBDRM) && \
        (!SOC_IMX95 || (GFX_MALI_IMX && GFX_IMX_DPU_G2D_V2)) && \
        (!SOC_IMX8QMMEK || GFX_IMX_DPU_G2D_V1) && \
        (!(SOC_IMX91 || SOC_IMX93) || GFX_IMX_PXP_G2D) && \
        (!(SOC_IMX8 || SOC_LS1028ARDB) || (GFX_IMX_GPU_G2D && GFX_GPU_VIV))
	help
	  Reference implementation of a Wayland compositor

endif # APP_GRAPHICS
```

## src/apps/ml/Kconfig
```kconfig
# ============================================================================
# AI/ML Configuration
# ============================================================================

config APP_ML
	bool "AI/ML frameworks"
	default y
	depends on PLATFORM_IMX
	help
	  Build AI/ML frameworks (TensorFlow Lite, etc.)

if APP_ML && PLATFORM_IMX


config ML_EIQ_EXAMPLES
	bool "eIQ ML examples"
	default y
	depends on SOC_IMX93 && ML_TFLITE
	help
	  NXP eIQ machine learning examples and demos

config ML_ETHOSU_DRIVER_STACK
	bool "Ethos-U NPU driver stack"
	default y
	depends on SOC_IMX93 && ML_ETHOSU_FIRMWARE && ML_FLATBUFFERS && ML_TFLITE
	help
	  Arm Ethos-U NPU driver stack

config ML_ETHOSU_FIRMWARE
	bool "Ethos-U NPU firmware"
	default y
	depends on SOC_IMX93
	help
	  Firmware for Arm Ethos-U NPU

config ML_ETHOSU_VELA
	bool "Ethos-U Vela compiler"
	default y
	depends on SOC_IMX93 && ML_ETHOSU_DRIVER_STACK
	help
	  Neural network compiler for Arm Ethos-U NPU

config ML_FLATBUFFERS
	bool "FlatBuffers serialization library"
	default y
	help
	  Memory efficient serialization library

config ML_NEUTRON
	bool "Neutron NPU driver"
	default y
	depends on SOC_IMX95
	help
	  NXP Neutron NPU driver and runtime

config ML_NNSHARK
	bool "nnshark profiling tool"
	default y
	depends on SOC_IMX8 && MM_GST_PLUGINS_BAD && GFX_LIBGPUPERFCNT && ML_NNSTREAMER
	help
	  Neural network profiling tool for NNStreamer

config ML_NNSTREAMER_EDGE
	bool "NNStreamer Edge"
	default y
	help
	  NNStreamer for edge AI applications

config ML_NNSTREAMER
	bool "NNStreamer"
	default y
    depends on SOC_IMX8 || SOC_IMX95 || SOC_IMX93
	depends on MM_GSTREAMER && MM_GST_PLUGINS_BASE && ML_NNSTREAMER_EDGE && ML_TFLITE
	help
	  Neural network streaming framework based on GStreamer

# config ML_PYTORCH
# 	bool "PyTorch deep learning framework"
# 	default y
# 	help
# 	  PyTorch machine learning framework

config ML_SSAT
	bool "SSAT - Shell Script Automated Tester"
	default y
    depends on ML_NNSTREAMER
	help
	  Testing framework for NNStreamer

config ML_TFLITE_ETHOSU_DELEGATE
	bool "TensorFlow Lite Ethos-U delegate"
	default y
	depends on SOC_IMX93 && ML_TFLITE && ML_ETHOSU_DRIVER_STACK
	help
	  TensorFlow Lite delegate for Arm Ethos-U NPU

config ML_TFLITE
	bool "TensorFlow Lite"
	default y
	depends on ML_FLATBUFFERS
	help
	  TensorFlow Lite inference framework

config ML_TFLITE_NEUTRON_DELEGATE
	bool "TensorFlow Lite Neutron delegate"
	default y
	depends on SOC_IMX95 && ML_TFLITE && ML_NEUTRON
	help
	  TensorFlow Lite delegate for NXP Neutron NPU

config ML_TFLITE_VX_DELEGATE
	bool "TensorFlow Lite VX delegate"
	default y
	depends on SOC_IMX8 && ML_TFLITE && ML_TIM_VX
	help
	  TensorFlow Lite delegate for Vivante NPU

config ML_TIM_VX
	bool "TIM-VX - Tensor Interface Module"
	default y
	depends on SOC_IMX8 && GFX_GPU_VIV
	help
	  Tensor Interface Module for Vivante NPU

# config ML_TVM
# 	bool "Apache TVM deep learning compiler"
# 	default y
# 	help
# 	  Apache TVM deep learning compiler stack


endif # APP_ML
```
