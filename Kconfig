## src/apps/multimedia/Kconfig
```kconfig
# ============================================================================
# Multimedia Configuration
# ============================================================================


config APP_MULTIMEDIA
	bool "Multimedia applications"
	default y
	depends on PLATFORM_IMX
	help
	  Build multimedia applications (GStreamer, ALSA, codecs, etc.)

if APP_MULTIMEDIA && PLATFORM_IMX

config MM_ALSA_LIB
	bool "ALSA library"
	default y
	help
	  Advanced Linux Sound Architecture library

config MM_ALSA_STATE
	bool "ALSA state management"
	default y
	depends on MM_ALSA_LIB
	help
	  ALSA state management utilities

#config MM_BASLER_CAMERA
#	bool "Basler camera support"
#	default y
#	help
#	  Basler industrial camera support

config MM_CHEESE
	bool "Cheese webcam application"
	default y
	depends on SOC_IMX8 || SOC_IMX95
	depends on MM_GSTREAMER && MM_GST_PLUGINS_BAD && GFX_CLUTTER_GST
	help
	  GNOME webcam application

config MM_GSTREAMER
	bool "GStreamer multimedia framework"
	default y
	help
	  GStreamer multimedia framework core

config MM_GST_PLUGINS_BASE
	bool "GStreamer base plugins"
	default y
	depends on (MM_GSTREAMER && MM_ALSA_LIB && GFX_WAYLAND_PROTOCOLS && GFX_LIBDRM) && \
               (!SOC_IMX8   || (GFX_GPU_VIV && GFX_IMX_GPU_G2D)) && \
               (!SOC_IMX95  || (GFX_MALI_IMX && GFX_IMX_DPU_G2D_V2)) && \
               (!SOC_IMX8QM || (GFX_GPU_VIV && GFX_IMX_DPU_G2D_V1))
	help
	  GStreamer base plugins set

config MM_GST_PLUGINS_GOOD
	bool "GStreamer good plugins"
	default y
	depends on MM_GSTREAMER && MM_GST_PLUGINS_BASE && GFX_LIBDRM
	help
	  GStreamer good quality plugins with good license

config MM_GST_PLUGINS_BAD
	bool "GStreamer bad plugins"
	default y
	depends on MM_GSTREAMER && MM_GST_PLUGINS_BASE
	help
	  GStreamer plugins with potential quality or licensing issues

#config MM_GST_PLUGINS_UGLY
#	bool "GStreamer ugly plugins"
#	default y
#	depends on MM_GSTREAMER
#	depends on MM_GST_PLUGINS_BASE
#	help
#	  GStreamer plugins with licensing issues

config MM_GST_PYTHON
	bool "GStreamer Python bindings"
	default y
	depends on MM_GSTREAMER && MM_GST_PLUGINS_BAD
	help
	  Python bindings for GStreamer

config MM_IMX_ALSA_PLUGIN
	bool "i.MX ALSA plugins"
	default y
	depends on MM_ALSA_LIB && MM_IMX_SW_PDM
	help
	  i.MX specific ALSA plugins

config MM_IMX_CODEC
	bool "i.MX codec libraries"
	default y
	help
	  i.MX hardware codec support libraries

config MM_IMX_DSPC_ASRC
	bool "i.MX DSPC ASRC"
	default y
	depends on SOC_IMX8 && MM_IMX_DSP
	help
	  i.MX DSP-based Asynchronous Sample Rate Converter

config MM_IMX_DSP_CODEC_EXT
	bool "i.MX DSP codec extensions"
	default y
    depends on SOC_IMX8 && MM_IMX_DSP
	help
	  i.MX DSP codec extensions

config MM_IMX_DSP
	bool "i.MX DSP support"
	default y
	depends on SOC_IMX8
	help
	  i.MX DSP audio processing support

config MM_IMX_GST_PLUGIN
	bool "i.MX GStreamer plugins"
	default y
	depends on (MM_GSTREAMER && MM_GST_PLUGINS_BAD && MM_IMX_CODEC && MM_IMX_PARSER && MM_IMX_LIB && GFX_LIBDRM) && \
	           (!SOC_IMX8M || (MM_IMX_VPUWRAP && MM_IMX_VPU_HANTRO_VC && GFX_IMX_GPU_G2D)) &&  \
	           (!(SOC_IMX91 || SOC_IMX93) || GFX_IMX_PXP_G2D) && \
	           (!SOC_IMX95 || GFX_IMX_DPU_G2D_V2) && \
	           (!SOC_IMX8QM || GFX_IMX_DPU_G2D_V1)
	help
	  i.MX hardware accelerated GStreamer plugins

config MM_IMX_ISP
	bool "i.MX ISP support"
	default y
	depends on GFX_LIBDRM && SOC_IMX8M && GFX_GPU_VIV && GFX_IMX_GPU_G2D
	help
	  i.MX Image Signal Processor support

config MM_IMX_LIB
	bool "i.MX multimedia libraries"
	default y
	help
	  i.MX multimedia support libraries

config MM_IMX_PARSER
	bool "i.MX parser libraries"
	default y
	help
	  i.MX multimedia parser libraries

config MM_IMX_SW_PDM
	bool "i.MX software PDM"
	default y
	help
	  i.MX software PDM microphone support

config MM_IMX_VPU_HANTRO_DAEMON
	bool "i.MX VPU Hantro daemon"
	default y
	depends on SOC_IMX8M && MM_IMX_VPU_HANTRO && MM_IMX_VPU_HANTRO_VC
	help
	  i.MX VPU Hantro hardware daemon

config MM_IMX_VPU_HANTRO
	bool "i.MX VPU Hantro driver"
	default y
	depends on SOC_IMX8M
	help
	  i.MX VPU Hantro hardware video processing unit driver

config MM_IMX_VPU_HANTRO_VC
	bool "i.MX VPU Hantro VC8000E"
	default y
	depends on SOC_IMX8M
	# depends on SOC_IMX8MP
	help
	  i.MX VPU Hantro VC8000E encoder support

config MM_IMX_VPUWRAP
	bool "i.MX VPU wrapper"
	default y
	depends on SOC_IMX8M && MM_IMX_VPU_HANTRO && MM_IMX_VPU_HANTRO_VC
	help
	  i.MX VPU wrapper library

config MM_LIBCAMERA
	bool "libcamera framework"
	default y
	depends on MM_GSTREAMER && MM_GST_PLUGINS_BASE && GFX_LIBDRM
    depends on (SOC_IMX8 && GFX_GPU_VIV) || (SOC_IMX95 && GFX_MALI_IMX)
	help
	  Modern camera support library for Linux

config MM_NEO_IPA_UGUZZI
	bool "Neo IPA Uguzzi"
	default y
	depends on SOC_IMX95 && MM_LIBCAMERA
	help
	  Neo Image Processing Algorithms for Uguzzi

config MM_SOF_ZEPHYR
	bool "Sound Open Firmware with Zephyr"
	default y
	help
	  Sound Open Firmware running on Zephyr RTOS


endif # APP_MULTIMEDIA && PLATFORM_IMX
```

## src/apps/networking/Kconfig
```kconfig
# ============================================================================
# Networking Configuration
# ============================================================================

config APP_NETWORKING
	bool "Networking applications"
	default y
	help
	  Build networking applications (DPDK, OVS, TSN tools, etc.)

if APP_NETWORKING


config NET_AIOPSL
	bool "AIOP Service Layer"
	default n
	depends on PLATFORM_LS
	help
	  AIOP (Advanced I/O Processor) Service Layer for DPAA2

config NET_AQUANTIA_FW_UTIL
	bool "Aquantia firmware utilities"
	default n
	depends on PLATFORM_LS
	help
	  Firmware utilities for Aquantia network adapters

config NET_CEETM
	bool "CEETM QoS support"
	default n
	depends on PLATFORM_LS
	help
	  Customer Edge Egress Traffic Management for QoS

config NET_DCE
	bool "Data Compression Engine"
	default n
	depends on PLATFORM_LS
	help
	  DPAA2 Data Compression Engine support

config NET_DPDK
	bool "DPDK - Data Plane Development Kit"
	default y if PLATFORM_LS
	default n if PLATFORM_IMX
	help
	  Data Plane Development Kit for fast packet processing

config NET_FLIB
	bool "DPAA Frame Manager library"
	default n
	depends on PLATFORM_LS
	help
	  DPAA Frame Manager user space library

config NET_FMC
	bool "Frame Manager Configuration tool"
	default n
	depends on PLATFORM_LS
	select NET_FMLIB
	help
	  Frame Manager Configuration tool for DPAA

config NET_FMLIB
	bool "Frame Manager library"
	default n
	depends on PLATFORM_LS
	select NET_FLIB
	help
	  Frame Manager user space library for DPAA

config NET_GPP_AIOPTOOL
	bool "GPP AIOP programming tool"
	default n
	depends on PLATFORM_LS
	select NET_AIOPSL
	help
	  General Purpose Processor tool for AIOP programming

#config NET_OVS_DPDK
#	bool "Open vSwitch with DPDK"
#	default n
#	depends on PLATFORM_LS
#	select NET_DPDK
#	help
#	  Open vSwitch accelerated with DPDK

config NET_PKTGEN_DPDK
	bool "Pktgen for DPDK"
	default n
	depends on PLATFORM_LS
	select NET_DPDK
	help
	  High-performance packet generator built on DPDK

config NET_QBMAN_USERSPACE
	bool "QBMan userspace driver"
	default n
	depends on PLATFORM_LS
	help
	  Queue and Buffer Manager userspace driver for DPAA

config NET_RESTOOL
	bool "DPAA2 resource manager tool"
	default n
	depends on PLATFORM_LS
	help
	  Resource manager tool for DPAA2 objects

config NET_SPC
	bool "Soft Parser Configuration tool"
	default n
	depends on PLATFORM_LS
	help
	  Soft Parser Configuration tool for DPAA2

config NET_TSNTOOL
	bool "TSN (Time-Sensitive Networking) tools"
	default n
	help
	  Tools for Time-Sensitive Networking configuration

#config NET_VPP
#	bool "VPP - Vector Packet Processing"
#	default n
#	depends on PLATFORM_LS
#	select NET_DPDK
#	help
#	  Fast, scalable layer 2-4 multi-platform network stack


endif # APP_NETWORKING
```

## src/apps/security/Kconfig
```kconfig
# ============================================================================
# Security Configuration
# ============================================================================

config APP_SECURITY
	bool "Security applications"
	default y
	help
	  Build security applications (OP-TEE, crypto libraries, etc.)

if APP_SECURITY


config SEC_CRCONF
	bool "CrConf - Linux crypto layer configuraton tool"
	default y
	help
	  Cryptographic configuration tool

config SEC_CST
	bool "Code Signing Tool"
	default y
	depends on PLATFORM_LS && SECURE_BOOT
	help
	  NXP Code Signing Tool for secure boot

config SEC_ECC_EXAMPLE
	bool "ECC cryptography examples"
	default y
	depends on PLATFORM_IMX && SEC_OPENSSL
	help
	  Elliptic Curve Cryptography example applications

config SEC_IMX_SECURE_ENCLAVE
	bool "i.MX Secure Enclave"
	default y
	depends on (SOC_IMX93 || SOC_IMX95) && SEC_OPENSSL && SEC_MBEDTLS
	help
	  i.MX Secure Enclave firmware and libraries

config SEC_IMX_SMW
    bool "i.MX Security Middleware Library"
    default y
    depends on PLATFORM_IMX && SEC_OPTEE_CLIENT && SEC_OPTEE_OS
    help
      i.MX Security Middleware Library

config SEC_KEYCTL_CAAM
    bool "CAAM keyctl utility"
    default y
    depends on SEC_OPENSSL
    help
      Key control utility for CAAM (Cryptographic Acceleration and Assurance Module)

config SEC_LIBPKCS11
	bool "PKCS#11 cryptographic library"
	default y
	depends on PLATFORM_LS && OPTEE && SEC_SECURE_OBJ && SEC_OPENSSL
	help
	  PKCS#11 Cryptographic Token Interface library

config SEC_MBEDTLS
	bool "Mbed TLS cryptographic library"
	default y
	help
	  Lightweight cryptographic and SSL/TLS library

config SEC_OPENSSL
	bool "OpenSSL cryptographic library"
	default y
	help
	  Full-featured cryptographic library and toolkit

config SEC_OPENSSL_PROVIDER_SE05X
	bool "OpenSSL provider for SE05x secure element"
	default n
	depends on PLATFORM_IMX && SEC_OPENSSL
	help
	  OpenSSL provider for NXP SE05x secure element

config SEC_OPTEE_CLIENT
	bool "OP-TEE client libraries"
	default y
	depends on OPTEE && SEC_OPTEE_OS
	help
	  OP-TEE client libraries and utilities

config SEC_OPTEE_OS
	bool "OP-TEE Trusted OS"
	default y
	depends on OPTEE
	help
	  Open Portable Trusted Execution Environment OS

config SEC_OPTEE_TEST
	bool "OP-TEE test suite"
	default y
	depends on OPTEE && SEC_OPTEE_CLIENT && SEC_OPTEE_OS
	help
	  OP-TEE compliance test suite and examples

config SEC_SECURE_OBJ
	bool "Secure Object library"
	default y
	depends on OPTEE && SEC_OPTEE_CLIENT && SEC_OPTEE_OS
	help
	  Secure Object library for trusted applications


endif # APP_SECURITY
```

## src/apps/utils/Kconfig
```kconfig
# ============================================================================
# Utility Configuration
# ============================================================================

config APP_UTILS
	bool "Firmware, mcore demos and others"
	default y
	help
	  Build Firmware, mcore demos and wireless firmware etc.

if APP_UTILS


if PLATFORM_IMX

config UTILS_FIRMWARED
	bool "Firmware loading daemon"
	default y
	help
	  Firmware loading daemon for system devices, like ap1302 camera

config UTILS_IMX_FIRMWARE
	bool "NXP WIFI module firmware"
	default y
	help
	  NXP WIFI module, like IW612, SD8997 etc, firmware

config UTILS_IMX_TEST
	bool "i.MX test utilities"
	default n
	depends on SOC_IMX8
	help
	  Test utilities and unit tests for i.MX platforms

config UTILS_MCORE_DEMO
	bool "M-core demo applications"
	default y
	help
	  Demo applications for i.MX M-core (Cortex-M) processors

config UTILS_WIRELESS_REGDB
	bool "Wireless regulatory database"
	default y
	help
	  Wireless regulatory database for WiFi compliance

endif # PLATFORM_IMX

config UTILS_FIRMWARE_IMX
	bool "i.MX system firmware package"
	default y
	depends on PLATFORM_IMX || SOC_LS1028ARDB
	help
	  Firmware binaries for i.MX platforms (HDMI, VPU, etc.)

config UTILS_PERF
    bool "Kernel perf tool"
    default y
    help
      This enables the 'perf' user-space tool for performance analysis.

endif # APP_UTILS
```

## src/linux/Kconfig
```kconfig
# ============================================================================
# Linux Kernel Modules Configuration
# ============================================================================
config LINUX_KMOD
    bool "Linux Kernel Modules"
    default y
    help
      Select the linux kernel out-of-tree modules.

if LINUX_KMOD

config CRYPTODEV_LINUX
	bool "Cryptodev Linux Module"
	default y
	help
	  Cryptodev-linux is a device that allows access to Linux kernel
	  cryptographic drivers; thus allowing userspace applications to
	  take advantage of hardware accelerators.

config ISP_VVCAM_MODULE
	bool "ISP VVCAM Module"
	default y
	depends on PLATFORM_IMX && SOC_IMX8MP
	help
	  ISP (Image Signal Processor) VVCAM (Vivante Video Capture and
	  Memory) module for i.MX platforms. Provides camera and image
	  processing support.

config NXP_WLAN_BT
	bool "NXP WLAN/Bluetooth Module"
	default y
    depends on PLATFORM_IMX
	help
	  NXP wireless LAN and Bluetooth driver module.
	  Supports NXP WiFi and Bluetooth chipsets.

config MDIO_PROXY_MODULE
	bool "MDIO Proxy Module"
	default y
	depends on PLATFORM_LS
	help
	  MDIO (Management Data Input/Output) proxy module for LayerScape
	  platforms. Provides interface for managing Ethernet PHYs.

endif # LINUX_KMOD
```
