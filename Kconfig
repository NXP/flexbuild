## configs/buildroot/arm64_tiny_defconfig
```kconfig
# Architecture
BR2_aarch64=y

# Toolchain
BR2_TOOLCHAIN=y
BR2_TOOLCHAIN_USES_GLIBC=y
BR2_TOOLCHAIN_EXTERNAL=y
BR2_TOOLCHAIN_EXTERNAL_LINARO_AARCH64=y
BR2_PACKAGE_PROVIDES_TOOLCHAIN_EXTERNAL="toolchain-external-linaro-aarch64"
BR2_TOOLCHAIN_EXTERNAL_PREFIX="aarch64-linux-gnu"

# Download
BR2_DL_DIR="$(HOME)/.buildrootdl"

# Filesystem
BR2_TARGET_ROOTFS_EXT2=y
BR2_TARGET_ROOTFS_EXT2_4=y
BR2_TARGET_ROOTFS_EXT2_SIZE="512M"
BR2_TARGET_ROOTFS_EXT2_GZIP=y
BR2_TARGET_ROOTFS_EXT2_EXTRA_BLOCKS=102400
BR2_TARGET_ROOTFS_EXT2_EXTRA_INODES=102400
BR2_TARGET_ROOTFS_CPIO=y
BR2_TARGET_ROOTFS_CPIO_GZIP=y
BR2_TARGET_ROOTFS_JFFS2=y
BR2_TARGET_ROOTFS_JFFS2_CUSTOM=y
BR2_TARGET_ROOTFS_JFFS2_CUSTOM_PAGESIZE=0x20
BR2_TARGET_ROOTFS_JFFS2_CUSTOM_EBSIZE=0x20000
BR2_TARGET_ROOTFS_SQUASHFS=y
BR2_TARGET_ROOTFS_SQUASHFS4_XZ=y
BR2_TARGET_ROOTFS_UBIFS=y
BR2_TARGET_ROOTFS_UBIFS_LEBSIZE=0x3e000
BR2_TARGET_ROOTFS_UBIFS_MINIOSIZE=0x1000
BR2_TARGET_ROOTFS_UBIFS_MAXLEBCNT=2082
BR2_TARGET_ROOTFS_UBI=y
BR2_TARGET_ROOTFS_UBI_PEBSIZE=0x40000
BR2_TARGET_ROOTFS_UBI_SUBSIZE=0
BR2_ROOTFS_POST_BUILD_SCRIPT="$(FBDIR)/configs/buildroot/post-build.sh"
BR2_ROOTFS_POST_IMAGE_SCRIPT="$(FBDIR)/configs/buildroot/post-image.sh"

# Hostname and issue
BR2_TARGET_GENERIC_HOSTNAME="SDK"
BR2_TARGET_GENERIC_ISSUE="SDK.Tiny Buildroot"

# Target packages
BR2_PACKAGE_MTD=y
BR2_PACKAGE_SYSSTAT=y
BR2_PACKAGE_RT_TESTS=y
BR2_PACKAGE_OPENSSH=y
BR2_PACKAGE_DOSFSTOOLS=y
BR2_PACKAGE_DOSFSTOOLS_FATLABEL=y
BR2_PACKAGE_DOSFSTOOLS_FSCK_FAT=y
BR2_PACKAGE_DOSFSTOOLS_MKFS_FAT=y
BR2_PACKAGE_DEVMEM2=y
BR2_PACKAGE_EVTEST=y
BR2_PACKAGE_DBUS=y
BR2_PACKAGE_GVFS=y
BR2_PACKAGE_I2C_TOOLS=y
BR2_PACKAGE_ETHTOOL=y
BR2_PACKAGE_RNG_TOOLS=y
BR2_PACKAGE_IPERF=y
BR2_PACKAGE_IPTABLES=y
BR2_PACKAGE_WGET=y
BR2_PACKAGE_BASH=y
BR2_PACKAGE_PTP4L=y
BR2_PACKAGE_CA_CERTIFICATES=y
BR2_PACKAGE_DHCPCD=y
BR2_PACKAGE_E2FSPROGS=y
BR2_PACKAGE_E2FSPROGS_RESIZE2FS=y
BR2_PACKAGE_PARTED=y
BR2_PACKAGE_CURL=y
BR2_PACKAGE_UTIL_LINUX=y
BR2_PACKAGE_UTIL_LINUX_BINARIES=y
BR2_PACKAGE_UTIL_LINUX_MOUNT=y
BR2_PACKAGE_UTIL_LINUX_MOUNTPOINT=y
BR2_PACKAGE_UTIL_LINUX_PIVOT_ROOT=y
BR2_PACKAGE_LIBGLIB2=y
BR2_PACKAGE_LIBXML2=y
BR2_PACKAGE_TCLAP=y
BR2_PACKAGE_RUNC=y
BR2_PACKAGE_SUDO=y
BR2_PACKAGE_WHICH=y
BR2_PACKAGE_FILE=y
BR2_PACKAGE_TAR=y
BR2_PACKAGE_EXPAT=y
BR2_PACKAGE_LIBCGROUP=y
BR2_PACKAGE_BUSYBOX_SHOW_OTHERS=y
BR2_PACKAGE_BUSYBOX_CONFIG_FRAGMENT_FILES="$(FBDIR)/configs/buildroot/lsdk-busybox.config"

# packages on host
BR2_PACKAGE_HOST_LINUX_HEADERS_CUSTOM_4_9=y
BR2_PACKAGE_HOST_DOSFSTOOLS=y
BR2_PACKAGE_HOST_GENIMAGE=y
BR2_PACKAGE_HOST_MTOOLS=y
```

## configs/linux/linux_arm32_IMX.its
```
/*
 * Copyright 2018 NXP
 *
 */


/dts-v1/;

/ {
	description = "Image file for the i.MX6 ARM 32b Linux Kernel";
	#address-cells = <1>;

	images {
		kernel {
			description = "ARM32 Linux kernel";
			data = /incbin/("../../build/linux/kernel/arm32/IMX/zImage");
			type = "kernel";
			arch = "arm";
			os = "linux";
			compression = "none";
                        load = <0x30000000>;
                        entry = <0x30000000>;
		};
		kernel-1 {
			description = "ARM32 Linux kernel";
			data = /incbin/("../../build/linux/kernel/arm32/IMX/zImage");
			type = "kernel";
			arch = "arm";
			os = "linux";
			compression = "none";
                        load = <0x80000000>;
                        entry = <0x80000000>;
		};

		initrd {
			description = "initrd for arm32";
			data = /incbin/("../../build/images/rootfs_yocto_arm32_tiny.cpio.gz");
			type = "ramdisk";
			arch = "arm";
			os = "linux";
			compression = "gzip";
                        load = <0x32800000>;
                        entry = <0x32800000>;
		};
		initrd-imx7 {
			description = "initrd for arm32";
			data = /incbin/("../../build/images/rootfs_yocto_arm32_tiny.cpio.gz");
			type = "ramdisk";
			arch = "arm";
			os = "linux";
			compression = "gzip";
                        load = <0x82800000>;
                        entry = <0x82800000>;
		};


		imx6qsabresd-dtb {
			description = "Flattened Device Tree blob";
			data = /incbin/("../../build/linux/kernel/arm32/IMX/imx6q-sabresd.dtb");
			type = "flat_dt";
			arch = "arm";
			compression = "none";
			load = <0x38000000>;
		};
		imx6qpsabresd-dtb {
			description = "Flattened Device Tree blob";
			data = /incbin/("../../build/linux/kernel/arm32/IMX/imx6qp-sabresd.dtb");
			type = "flat_dt";
			arch = "arm";
			compression = "none";
			load = <0x38000000>;
		};
		imx7ulpevk-dtb {
			description = "Flattened Device Tree blob";
			data = /incbin/("../../build/linux/kernel/arm32/IMX/imx7ulp-evk.dtb");
			type = "flat_dt";
			arch = "arm";
			compression = "none";
			load = <0x88000000>;
		};
		imx6sllevk-dtb {
			description = "Flattened Device Tree blob";
			data = /incbin/("../../build/linux/kernel/arm32/IMX/imx6sll-evk.dtb");
			type = "flat_dt";
			arch = "arm";
			compression = "none";
			load = <0x88000000>;
		};
	};

	configurations {
		imx6qsabresd {
			description = "Boot Linux kernel";
			kernel = "kernel";
			fdt = "imx6qsabresd-dtb";
			ramdisk = "initrd";
		};
		imx6qpsabresd {
		        description = "Boot Linux kernel";
			kernel = "kernel";
			fdt = "imx6qpsabresd-dtb";
			ramdisk = "initrd";
		};
		imx6sllevk {
			description = "Boot Linux kernel";
			kernel = "kernel-1";
			fdt = "imx6sllevk-dtb";
			ramdisk = "initrd-imx7";
		};
		imx7ulpevk {
			description = "Boot Linux kernel";
			kernel = "kernel-1";
			fdt = "imx7ulpevk-dtb";
			ramdisk = "initrd-imx7";
		};
	};
};
```

## configs/linux/linux_arm32_LS.its
```
/*
 * Copyright 2017 - 2020 NXP
 *
 */


/dts-v1/;

/ {
	description = "Image file for the QorIQ ARM 32b Linux Kernel";
	#address-cells = <1>;

	images {
		kernel-v7 {
			description = "ARM32 Linux kernel";
			data = /incbin/("../../build/linux/kernel/arm32/LS/zImage");
			type = "kernel";
			arch = "arm";
			os = "linux";
			compression = "none";
			load = <0x80008000>;
			entry = <0x80008000>;
		};

		initrd {
			description = "initrd for arm32";
			data = /incbin/("../../build/images/rootfs_poky_tiny_arm32.cpio.gz");
			type = "ramdisk";
			arch = "arm";
			os = "linux";
			compression = "none";
		};

		ls1021atwr-dtb {
			description = "ls1021atwr-dtb";
			data = /incbin/("../../build/linux/kernel/arm32/LS/ls1021a-twr.dtb");
			type = "flat_dt";
			arch = "arm";
			compression = "none";
			load = <0x90000000>;
		};


		ls1021aqds-dtb {
			description = "ls1021aqds-dtb";
			data = /incbin/("../../build/linux/kernel/arm32/LS/ls1021a-qds.dtb");
			type = "flat_dt";
			arch = "arm";
			compression = "none";
			load = <0x90000000>;
		};

	};

	configurations {
		ls1021atwr {
			description = "config for ls1021atwr";
			kernel = "kernel-v7";
			fdt = "ls1021atwr-dtb";
			ramdisk = "initrd";
		};

		ls1021aqds {
			description = "config for ls1021aqds";
			kernel = "kernel-v7";
			fdt = "ls1021aqds-dtb";
			ramdisk = "initrd";
		};
	};
};
```

## configs/linux/linux_arm64_IMX.its
```
/*
 * Copyright 2018-2025 NXP
 *
 * Shengzhou Liu <Shengzhou.Liu@nxp.com>
 *
 */


/dts-v1/;

/ {
	description = "generate itb image for i.MX ARM 64bit Linux Kernel";
	#address-cells = <1>;

	images {
		kernel {
			description = "ARM64 Linux kernel";
			data = /incbin/("../../build/linux/kernel/arm64/IMX/Image.gz");
			type = "kernel";
			arch = "arm64";
			os = "linux";
			compression = "gzip";
			load = <0x94280000>;
			entry = <0x94280000>;
		};

		initrd {
			description = "initrd for arm64";
			data = /incbin/("../../build/images/rootfs_poky_tiny_arm64.cpio.gz");
			type = "ramdisk";
			arch = "arm64";
			os = "linux";
			load = <0x00000000>;
			entry = <0x00000000>;
		};

		imx8mpevk-dtb {
			description = "Flattened Device Tree blob";
			data = /incbin/("../../build/linux/kernel/arm64/IMX/imx8mp-evk.dtb");
			type = "flat_dt";
			arch = "arm64";
			os = "linux";
			compression = "none";
			load = <0x90000000>;
		};
		imx8mpfrdm-dtb {
			description = "Flattened Device Tree blob";
			data = /incbin/("../../build/linux/kernel/arm64/IMX/imx8mp-frdm.dtb");
			type = "flat_dt";
			arch = "arm64";
			os = "linux";
			compression = "none";
			load = <0x90000000>;
		};
		imx8qmmek-dtb {
			description = "Flattened Device Tree blob";
			data = /incbin/("../../build/linux/kernel/arm64/IMX/imx8qm-mek.dtb");
			type = "flat_dt";
			arch = "arm64";
			os = "linux";
			compression = "none";
			load = <0x90000000>;
		};
		imx8mmevk-dtb {
			description = "Flattened Device Tree blob";
			data = /incbin/("../../build/linux/kernel/arm64/IMX/imx8mm-evk.dtb");
			type = "flat_dt";
			arch = "arm64";
			os = "linux";
			compression = "none";
			load = <0x90000000>;
		};
		imx91evk-dtb {
			description = "Flattened Device Tree blob";
			data = /incbin/("../../build/linux/kernel/arm64/IMX/imx91-11x11-evk.dtb");
			type = "flat_dt";
			arch = "arm64";
			os = "linux";
			compression = "none";
			load = <0x90000000>;
		};
		imx91frdm-dtb {
			description = "Flattened Device Tree blob";
			data = /incbin/("../../build/linux/kernel/arm64/IMX/imx91-11x11-frdm.dtb");
			type = "flat_dt";
			arch = "arm64";
			os = "linux";
			compression = "none";
			load = <0x90000000>;
		};
		imx91sfrdm-dtb {
			description = "Flattened Device Tree blob";
			data = /incbin/("../../build/linux/kernel/arm64/IMX/imx91-11x11-frdm-imx91s.dtb");
			type = "flat_dt";
			arch = "arm64";
			os = "linux";
			compression = "none";
			load = <0x90000000>;
		};
		imx93evk-dtb {
			description = "Flattened Device Tree blob";
			data = /incbin/("../../build/linux/kernel/arm64/IMX/imx93-11x11-evk.dtb");
			type = "flat_dt";
			arch = "arm64";
			os = "linux";
			compression = "none";
			load = <0x90000000>;
		};
		imx93frdm-dtb {
			description = "Flattened Device Tree blob";
			data = /incbin/("../../build/linux/kernel/arm64/IMX/imx93-11x11-frdm.dtb");
			type = "flat_dt";
			arch = "arm64";
			os = "linux";
			compression = "none";
			load = <0x90000000>;
		};
		imx95-15x15-evk-dtb {
			description = "Flattened Device Tree blob";
			data = /incbin/("../../build/linux/kernel/arm64/IMX/imx95-15x15-evk.dtb");
			type = "flat_dt";
			arch = "arm64";
			os = "linux";
			compression = "none";
			load = <0x90000000>;
		};
		imx95-15x15-frdm-dtb {
			description = "Flattened Device Tree blob";
			data = /incbin/("../../build/linux/kernel/arm64/IMX/imx95-15x15-frdm.dtb");
			type = "flat_dt";
			arch = "arm64";
			os = "linux";
			compression = "none";
			load = <0x90000000>;
		};
		imx95-19x19-evk-dtb {
			description = "Flattened Device Tree blob";
			data = /incbin/("../../build/linux/kernel/arm64/IMX/imx95-19x19-evk.dtb");
			type = "flat_dt";
			arch = "arm64";
			os = "linux";
			compression = "none";
			load = <0x90000000>;
		};
		imx95-19x19-frdm-pro-dtb {
			description = "Flattened Device Tree blob";
			data = /incbin/("../../build/linux/kernel/arm64/IMX/imx95-19x19-frdm-pro.dtb");
			type = "flat_dt";
			arch = "arm64";
			os = "linux";
			compression = "none";
			load = <0x90000000>;
		};
	};

	configurations {
		imx8mpevk {
			description = "Boot Linux kernel";
			kernel = "kernel";
			fdt = "imx8mpevk-dtb";
			ramdisk = "initrd";
		};
		imx8mpfrdm {
			description = "Boot Linux kernel";
			kernel = "kernel";
			fdt = "imx8mpfrdm-dtb";
			ramdisk = "initrd";
		};
		imx8mmevk {
			description = "Boot Linux kernel";
			kernel = "kernel";
			fdt = "imx8mmevk-dtb";
			ramdisk = "initrd";
		};
		imx8qmmek {
			description = "Boot Linux kernel";
			kernel = "kernel";
			fdt = "imx8qmmek-dtb";
			ramdisk = "initrd";
		};
		imx91evk {
			description = "Boot Linux kernel";
			kernel = "kernel";
			fdt = "imx91evk-dtb";
			ramdisk = "initrd";
		};
		imx91frdm {
			description = "Boot Linux kernel";
			kernel = "kernel";
			fdt = "imx91frdm-dtb";
			ramdisk = "initrd";
		};
		imx91sfrdm {
			description = "Boot Linux kernel";
			kernel = "kernel";
			fdt = "imx91sfrdm-dtb";
			ramdisk = "initrd";
		};
		imx93evk {
			description = "Boot Linux kernel";
			kernel = "kernel";
			fdt = "imx93evk-dtb";
			ramdisk = "initrd";
		};
		imx93frdm {
			description = "Boot Linux kernel";
			kernel = "kernel";
			fdt = "imx93frdm-dtb";
			ramdisk = "initrd";
		};
		imx95-15x15-evk {
			description = "Boot Linux kernel";
			kernel = "kernel";
			fdt = "imx95-15x15-evk-dtb";
			ramdisk = "initrd";
		};
		imx95-15x15-frdm {
			description = "Boot Linux kernel";
			kernel = "kernel";
			fdt = "imx95-15x15-frdm-dtb";
			ramdisk = "initrd";
		};
		imx95-19x19-evk {
			description = "Boot Linux kernel";
			kernel = "kernel";
			fdt = "imx95-19x19-evk-dtb";
			ramdisk = "initrd";
		};
		imx95-19x19-frdm-pro {
			description = "Boot Linux kernel";
			kernel = "kernel";
			fdt = "imx95-19x19-frdm-pro-dtb";
			ramdisk = "initrd";
		};
	};
};
```

## configs/linux/linux_arm64_LS.its
```
/*
 * Copyright 2017-2025 NXP
 *
 * Shengzhou Liu <Shengzhou.Liu@nxp.com>
 *
 */


/dts-v1/;

/ {
	description = "arm64 kernel, ramdisk and FDT blob";
	#address-cells = <1>;

	images {
		kernel {
			description = "ARM64 Kernel";
			data = /incbin/("../../build/linux/kernel/arm64/LS/Image.gz");
			type = "kernel";
			arch = "arm64";
			os = "linux";
			compression = "gzip";
			load = <0x84080000>;
			entry = <0x84080000>;
		};

		initrd {
			description = "initrd for arm64";
			data = /incbin/("../../build/images/rootfs_poky_tiny_arm64.cpio.gz");
			type = "ramdisk";
			arch = "arm64";
			os = "linux";
			load = <0x00000000>;
			entry = <0x00000000>;
		};
		ls1028ardb-dtb {
			description = "ls1028ardb-dtb";
			data = /incbin/("../../build/linux/kernel/arm64/LS/fsl-ls1028a-rdb.dtb");
			type = "flat_dt";
			arch = "arm64";
			os = "linux";
			compression = "none";
			load = <0x90000000>;
		};
		ls1043ardb-dtb {
			description = "ls1043ardb-dtb";
			data = /incbin/("../../build/linux/kernel/arm64/LS/fsl-ls1043a-rdb-sdk.dtb");
			type = "flat_dt";
			arch = "arm64";
			os = "linux";
			compression = "none";
			load = <0x90000000>;
		};
		ls1046ardb-dtb {
			description = "ls1046ardb-dtb";
			data = /incbin/("../../build/linux/kernel/arm64/LS/fsl-ls1046a-rdb-sdk.dtb");
			type = "flat_dt";
			arch = "arm64";
			os = "linux";
			compression = "none";
			load = <0x90000000>;
		};
		lx2160ardb-dtb {
			description = "lx2160ardb-dtb";
			data = /incbin/("../../build/linux/kernel/arm64/LS/fsl-lx2160a-rdb.dtb");
			type = "flat_dt";
			arch = "arm64";
			os = "linux";
			compression = "none";
			load = <0x90000000>;
		};
	};

	configurations {
		ls1028ardb {
			description = "config for ls1028ardb";
			kernel = "kernel";
			ramdisk = "initrd";
			fdt = "ls1028ardb-dtb";
		};

		ls1043ardb {
			description = "config for ls1043ardb";
			kernel = "kernel";
			ramdisk = "initrd";
			fdt = "ls1043ardb-dtb";
		};

		ls1046ardb {
			description = "config for ls1046ardb";
			kernel = "kernel";
			ramdisk = "initrd";
			fdt = "ls1046ardb-dtb";
		};

		lx2160ardb {
			description = "config for lx2160ardb";
			kernel = "kernel";
			ramdisk = "initrd";
			fdt = "lx2160ardb-dtb";
		};
	};
};
```
