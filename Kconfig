## Kconfig
```kconfig
# Flexbuild Main Configuration

mainmenu "Flexbuild Configuration LSDK System"


# ============================================================================
# Target Configuration Categories
# ============================================================================
config FLEXBUILD_VERSION
	string
	help
	  Flexbuild version string

choice
	prompt "Target Platform"
	default SOC_IMX93FRDM
	help
	  Select the target platform family

# Source board configurations
source "configs/board/Kconfig"

endchoice


# Helper symbols (outside choice block to avoid circular dependency)
config SOC_IMX8
	bool
	default y if SOC_IMX8MPEVK || SOC_IMX8MPFRDM || SOC_IMX8MMEVK || SOC_IMX8QMMEK

config SOC_IMX8M
	bool
	default y if SOC_IMX8MPEVK || SOC_IMX8MPFRDM || SOC_IMX8MMEVK

config SOC_IMX8MP
	bool
	default y if SOC_IMX8MPEVK || SOC_IMX8MPFRDM

config SOC_IMX8QM
	bool
	default y if SOC_IMX8QMMEK

config SOC_IMX8MM
	bool
	default y if SOC_IMX8MMEVK

config SOC_IMX91
	bool
	default y if SOC_IMX91SFRDM || SOC_IMX91FRDM || SOC_IMX91EVK

config SOC_IMX93
	bool
	default y if SOC_IMX93FRDM || SOC_IMX93EVK

config SOC_IMX95_15X15
	bool
	default y if SOC_IMX95_15X15_FRDM || SOC_IMX95_15X15_EVK

config SOC_IMX95_19X19
	bool
	default y if SOC_IMX95_19X19_FRDM_PRO || SOC_IMX95_19X19_EVK

config SOC_IMX95
	bool
	default y if SOC_IMX95_15X15 || SOC_IMX95_19X19

config SOC_LS104
    bool
    default y if SOC_LS1046ARDB || SOC_LS1043ARDB

config PLATFORM_IMX
    bool
    default y if SOC_IMX8 || SOC_IMX91 || SOC_IMX93 || SOC_IMX95

config PLATFORM_LS
    bool
    default y if SOC_LS1028ARDB || SOC_LS104 || SOC_LX2160ARDB

config MACHINE_NAME
    string
    default "imx8mpevk" if SOC_IMX8MPEVK
    default "imx8mpfrdm" if SOC_IMX8MPFRDM
    default "imx8mmevk" if SOC_IMX8MMEVK
    default "imx8qmmek" if SOC_IMX8QMMEK
    default "imx91evk" if SOC_IMX91EVK
    default "imx91frdm" if SOC_IMX91FRDM
    default "imx91sfrdm" if SOC_IMX91SFRDM
    default "imx93evk" if SOC_IMX93EVK
    default "imx93frdm" if SOC_IMX93FRDM
    default "imx95-15x15-evk" if SOC_IMX95_15X15_EVK
    default "imx95-15x15-frdm" if SOC_IMX95_15X15_FRDM
    default "imx95-19x19-evk" if SOC_IMX95_19X19_EVK
    default "imx95-19x19-frdm-pro" if SOC_IMX95_19X19_FRDM_PRO
    default "ls1028ardb" if SOC_LS1028ARDB
    default "ls1043ardb" if SOC_LS1043ARDB
    default "ls1046ardb" if SOC_LS1046ARDB
    default "lx2160ardb" if SOC_LX2160ARDB

# ============================================================================
# Build Configuration Categories
# ============================================================================
menu "Build Configuration"

config JOBS
	int "Parallel build jobs"
	range 0 24
	default 0
	help
	  Number of parallel make jobs to run.
	  Default is 0, which means use the number of CPU cores as parallel jobs.
	  Adjust based on your CPU cores and system resources.

config BUILD_VERBOSE
	bool "Verbose build output"
	default n
	help
	  Show detailed compilation commands during build

config KEEP_GIT
	bool "Use git clone to download source code"
	default n
	help
	  If enabled, use git clone to download source code repositories.
	  If disabled, use direct download (tarball/archive) method instead.
	  Git clone method keeps the full git history and allows for easier
	  development and contribution.
	  Using download method can speed up the build time by avoiding
	  full git history retrieval.

config OPTEE
	bool "Enable OPTEE feature"
	default n
	help
	  Use Open Portable Trusted Execution Environment(OPTEE)
	  designed to run secure code alongside a normal operating system

config SECURE_BOOT
	bool "Enable secure boot feature"
	default n
	depends on PLATFORM_LS
	help
	  Enable security feature that ensures only trusted software is
	  loaded during the device's startup process.

config LINUX_EXTRA_CONFIG
	string "Extra linux kernel configuration"
	help
	  Specify custom Linux kernel configuration file(s) to append to the default.
	  The configuration file(s) must be located in configs/linux/ directory.
	  For LayerScape platform, default is: defconfig lsdk.config
	  For i.MX platform, default is: imx_v8_defconfig

config CUSTOM_SDK_CONFIG
	string "Custom SDK configuration file"
	help
	  Specify a custom SDK configuration file to replace the default.
	  The configuration file(s) must be located in configs/ directory.
	  The default SDK configuration file is: sdk.yml.

config FUSE_PROVISIONING
	bool "Enable fuse provisioning"
	default n
	depends on PLATFORM_LS
	help
	  Provides non-volatile secure storage in form of on-chip fuse memory which some
	  information can be programmed into fuse memory via Security Fuse Processor (SFP)
	  designed to run secure code alongside a normal operating system

endmenu # Build Configuration


# ============================================================================
# Application Categories
# ============================================================================
menu "NXP Component Selection"

source "src/linux/Kconfig"
source "src/apps/Kconfig"

endmenu # Component Selection


# ============================================================================
# Rootfs Categories
# ============================================================================
#menu "Root Filesystem"
#
#config DISTRO_VERSION
#	string "Distribution version"
#	default "trixie"
#
#endmenu # Root Filesystem
```

## configs/board/Kconfig
```kconfig
# Platform Configuration

config SOC_IMX8MPEVK
	bool "i.MX 8M Plus EVK Board"
	help
	  imx8mpevk board

config SOC_IMX8MPFRDM
	bool "FRDM-IMX8MPLUS Board"
	help
	  imx8mpfrdm board

config SOC_IMX8MMEVK
	bool "i.MX 8M Mini EVK Board"
	help
	  imx8mmevk board

config SOC_IMX8QMMEK
	bool "i.MX 8QuadMax MEK Board"
	help
	  imx8qmmek board

config SOC_IMX91EVK
	bool "i.MX 91 EVK board (11x11 A1 silicon)"
	help
	  imx91evk board

config SOC_IMX91FRDM
	bool "FRDM-IMX91 board (11x11 A1 silicon)"
	help
	  imx91frdm board

config SOC_IMX91SFRDM
	bool "FRDM-IMX91S board (11x11 A1 silicon)"
	help
	  imx91sfrdm board

config SOC_IMX93EVK
	bool "i.MX 93 EVK board (11x11 A2 silicon)"
	help
	  imx93evk board

config SOC_IMX93FRDM
	bool "FRDM-IMX93 Board (11x11 A2 silicon)"
	help
	  imx93frdm board

config SOC_IMX95_15X15_EVK
	bool "i.MX 95 15x15 EVK Board (B0 silicon revision)"
	help
	  imx95-15x15-evk board

config SOC_IMX95_15X15_FRDM
	bool "FRDM-IMX95 board (15x15 B0 silicon revision)"
	help
	  imx95-15x15-frdm board

config SOC_IMX95_19X19_EVK
	bool "i.MX 95 19x19 EVK Board (B0 silicon revision)"
	help
	  imx95-19x19-evk board

config SOC_IMX95_19X19_FRDM_PRO
	bool "FRDM-PRO-IMX95 board (19x19 B0 silicon revision)"
	help
	  imx95-19x19-frdm-pro board

config SOC_LS1028ARDB
	bool "ls1028ardb board"
	help
	  ls1028ardb dual core processor board with tsn

config SOC_LS1043ARDB
	bool "ls1043ardb board"
	help
	  ls1043ardb quad core processor board

config SOC_LS1046ARDB
	bool "ls1046ardb board"
	help
	  ls1046ardb quad core processor board

config SOC_LX2160ARDB
	bool "lx2160ardb board"
	help
	  lx2160ardb sixteen core processor board
```

## configs/board/Kconfig.imx
```kconfig
# i.MX Platform Specific Configuration

if PLATFORM_IMX

config SOC_IMX8MPEVK
	bool "i.MX 8M Plus EVK Board"
	select ARCH_ARM64
	help
	  imx8mpevk board

config SOC_IMX8MPFRDM
	bool "FRDM-IMX8MPLUS Board"
	select ARCH_ARM64
	help
	  imx8mpfrdm board

config SOC_IMX8MMEVK
	bool "i.MX 8M Mini EVK Board"
	select ARCH_ARM64
	help
	  imx8mmevk board

config SOC_IMX8QMMEK
	bool "i.MX 8QuadMax MEK Board"
	select ARCH_ARM64
	help
	  imx8qmmek board

config SOC_IMX91EVK
	bool "i.MX 91 EVK board (11x11 A1 silicon)"
	select ARCH_ARM64
	help
	  imx91evk board

config SOC_IMX91FRDM
	bool "FRDM-IMX91 board (11x11 A1 silicon)"
	select ARCH_ARM64
	help
	  imx91frdm board

config SOC_IMX91SFRDM
	bool "FRDM-IMX91S board (11x11 A1 silicon)"
	select ARCH_ARM64
	help
	  imx91sfrdm board

config SOC_IMX93EVK
	bool "i.MX 93 EVK board (11x11 A2 silicon)"
	select ARCH_ARM64
	help
	  imx93evk board

config SOC_IMX93FRDM
	bool "FRDM-IMX93 Board (11x11 A2 silicon)"
	select ARCH_ARM64
	help
	  imx93frdm board

config SOC_IMX95_15X15_EVK
	bool "i.MX 95 15x15 EVK Board (B0 silicon revision)"
	select ARCH_ARM64
	help
	  imx95-15x15-evk board

config SOC_IMX95_15X15_FRDM
	bool "FRDM-IMX95 board (15x15 B0 silicon revision)"
	select ARCH_ARM64
	help
	  imx95-15x15-frdm board

config SOC_IMX95_19X19_EVK
	bool "i.MX 95 19x19 EVK Board (B0 silicon revision)"
	select ARCH_ARM64
	help
	  imx95-19x19-evk board

config SOC_IMX95_19X19_FRDM_PRO
	bool "FRDM-PRO-IMX95 board (19x19 B0 silicon revision)"
	select ARCH_ARM64
	help
	  imx95-19x19-frdm-pro board

endif # PLATFORM_IMX
```

## configs/buildroot/arm32_devel_defconfig
```kconfig
# Architecture
BR2_arm=y
BR2_ARM_FPU_NEON=y

# Toolchain
BR2_TOOLCHAIN=y
BR2_TOOLCHAIN_USES_GLIBC=y
BR2_TOOLCHAIN_EXTERNAL=y
BR2_TOOLCHAIN_EXTERNAL_CODESOURCERY_ARM=y
BR2_PACKAGE_PROVIDES_TOOLCHAIN_EXTERNAL="toolchain-external-codesourcery-arm"
BR2_TOOLCHAIN_EXTERNAL_PREFIX="arm-none-linux-gnueabi"

# Download
BR2_DL_DIR="$(HOME)/.buildrootdl"

# Filesystem
BR2_TARGET_ROOTFS_EXT2=y
BR2_TARGET_ROOTFS_EXT2_4=y
BR2_TARGET_ROOTFS_EXT2_SIZE="1024M"
BR2_TARGET_ROOTFS_EXT2_GZIP=y
BR2_TARGET_ROOTFS_EXT2_EXTRA_BLOCKS=102400
BR2_TARGET_ROOTFS_EXT2_EXTRA_INODES=102400
BR2_TARGET_ROOTFS_CPIO=y
BR2_TARGET_ROOTFS_CPIO_GZIP=y
BR2_TARGET_ROOTFS_JFFS2=y
BR2_TARGET_ROOTFS_JFFS2_CUSTOM=y
BR2_TARGET_ROOTFS_JFFS2_CUSTOM_PAGESIZE=0x20
BR2_TARGET_ROOTFS_JFFS2_CUSTOM_EBSIZE=0x20000
BR2_TARGET_ROOTFS_SQUASHFS=y
BR2_TARGET_ROOTFS_SQUASHFS4_XZ=y
BR2_TARGET_ROOTFS_UBIFS=y
BR2_TARGET_ROOTFS_UBIFS_LEBSIZE=0x3e000
BR2_TARGET_ROOTFS_UBIFS_MINIOSIZE=0x1000
BR2_TARGET_ROOTFS_UBIFS_MAXLEBCNT=2082
BR2_TARGET_ROOTFS_UBI=y
BR2_TARGET_ROOTFS_UBI_PEBSIZE=0x40000
BR2_TARGET_ROOTFS_UBI_SUBSIZE=0
BR2_ROOTFS_POST_BUILD_SCRIPT="$(FBDIR)/configs/buildroot/post-build.sh"
BR2_ROOTFS_POST_IMAGE_SCRIPT="$(FBDIR)/configs/buildroot/post-image.sh"

# Hostname and issue
BR2_TARGET_GENERIC_HOSTNAME="SDK"
BR2_TARGET_GENERIC_ISSUE="SDK Buildroot"

# Target packages
BR2_PACKAGE_MTD=y
BR2_PACKAGE_SYSSTAT=y
BR2_PACKAGE_RT_TESTS=y
BR2_PACKAGE_OPENSSH=y
BR2_PACKAGE_DOSFSTOOLS=y
BR2_PACKAGE_DOSFSTOOLS_FATLABEL=y
BR2_PACKAGE_DOSFSTOOLS_FSCK_FAT=y
BR2_PACKAGE_DOSFSTOOLS_MKFS_FAT=y
BR2_PACKAGE_DEVMEM2=y
BR2_PACKAGE_EVTEST=y
BR2_PACKAGE_DBUS=y
BR2_PACKAGE_GVFS=y
BR2_PACKAGE_I2C_TOOLS=y
BR2_PACKAGE_ETHTOOL=y
BR2_PACKAGE_RNG_TOOLS=y
BR2_PACKAGE_IPERF=y
BR2_PACKAGE_IPTABLES=y
BR2_PACKAGE_WGET=y
BR2_PACKAGE_BASH=y
BR2_PACKAGE_PTP4L=y
BR2_PACKAGE_CA_CERTIFICATES=y
BR2_PACKAGE_DHCPCD=y
BR2_PACKAGE_E2FSPROGS=y
BR2_PACKAGE_E2FSPROGS_RESIZE2FS=y
BR2_PACKAGE_PARTED=y
BR2_PACKAGE_UTIL_LINUX=y
BR2_PACKAGE_UTIL_LINUX_BINARIES=y
BR2_PACKAGE_UTIL_LINUX_MOUNT=y
BR2_PACKAGE_UTIL_LINUX_LIBMOUNT=y
BR2_PACKAGE_UTIL_LINUX_MOUNTPOINT=y
BR2_PACKAGE_UTIL_LINUX_PIVOT_ROOT=y
BR2_PACKAGE_LIBGLIB2=y
BR2_PACKAGE_LIBXML2=y
BR2_PACKAGE_TCLAP=y
BR2_PACKAGE_LIBPCAP=y
BR2_PACKAGE_LUA_5_3=y
BR2_PACKAGE_READLINE=y
BR2_PACKAGE_RUNC=y
BR2_PACKAGE_SUDO=y
BR2_PACKAGE_WHICH=y
BR2_PACKAGE_FILE=y
BR2_PACKAGE_TAR=y
BR2_PACKAGE_EXPAT=y
BR2_PACKAGE_BUSYBOX_SHOW_OTHERS=y
BR2_PACKAGE_BUSYBOX_CONFIG_FRAGMENT_FILES="$(FBDIR)/configs/buildroot/lsdk-busybox.config"

# xenomai package
BR2_PACKAGE_XENOMAI=y
BR2_PACKAGE_XENOMAI_ARCH_SUPPORTS=y
BR2_PACKAGE_XENOMAI_RTCAN=y
BR2_PACKAGE_XENOMAI_ANALOGY=y
BR2_PACKAGE_XENOMAI_NATIVE_SKIN=y
BR2_PACKAGE_XENOMAI_POSIX_SKIN=y
BR2_PACKAGE_XENOMAI_TESTSUITE=y

# docker package
BR2_PACKAGE_DOCKER_CONTAINERD=y
BR2_PACKAGE_DOCKER_ENGINE=y
BR2_PACKAGE_DOCKER_ENGINE_DAEMON=y
BR2_PACKAGE_DOCKER_ENGINE_EXPERIMENTAL=y
BR2_PACKAGE_DOCKER_ENGINE_DRIVER_BTRFS=y
BR2_PACKAGE_DOCKER_ENGINE_DRIVER_DEVICEMAPPER=y
BR2_PACKAGE_DOCKER_ENGINE_DRIVER_VFS=y
BR2_PACKAGE_CGROUPFS_MOUNT=y
BR2_PACKAGE_LIBCGROUP=y

# packages on host
BR2_PACKAGE_HOST_LINUX_HEADERS_CUSTOM_4_9=y
BR2_PACKAGE_HOST_DOSFSTOOLS=y
BR2_PACKAGE_HOST_GENIMAGE=y
BR2_PACKAGE_HOST_MTOOLS=y
```

## configs/buildroot/arm32_imaevm_defconfig
```kconfig
# Architecture
BR2_arm=y
BR2_ARM_FPU_NEON=y

# Toolchain
BR2_TOOLCHAIN=y
BR2_TOOLCHAIN_USES_GLIBC=y
BR2_TOOLCHAIN_EXTERNAL=y
BR2_TOOLCHAIN_EXTERNAL_CODESOURCERY_ARM=y
BR2_PACKAGE_PROVIDES_TOOLCHAIN_EXTERNAL="toolchain-external-codesourcery-arm"
BR2_TOOLCHAIN_EXTERNAL_PREFIX="arm-none-linux-gnueabi"

# Download
BR2_DL_DIR="$(HOME)/.buildrootdl"
BR2_ROOTFS_OVERLAY="$(FBOUTDIR)/rfs/rootfs_$(DISTRIB_VERSION)_buildroot_$(DISTROSCALE)_$(DESTARCH)/overlay"

# Hostname and issue
BR2_TARGET_GENERIC_HOSTNAME="lsdk-imaevm"
BR2_TARGET_GENERIC_ISSUE="LSDK initramfs IMA-EVM"

# Target packages
BR2_TARGET_ROOTFS_CPIO=y
BR2_TARGET_ROOTFS_CPIO_GZIP=y
BR2_PACKAGE_KEYUTILS=y
BR2_PACKAGE_UTIL_LINUX=y
BR2_PACKAGE_BUSYBOX_SHOW_OTHERS=y
BR2_PACKAGE_BUSYBOX_CONFIG="package/busybox/busybox.config"
BR2_PACKAGE_BUSYBOX_CONFIG_FRAGMENT_FILES=""

# BR2_INIT_BUSYBOX is not set
BR2_INIT_NONE=y
# BR2_TARGET_ENABLE_ROOT_LOGIN is not set
# BR2_TARGET_GENERIC_GETTY is not set
BR2_PACKAGE_PROVIDES_SKELETON="skeleton-init-none"
BR2_PACKAGE_SKELETON_INIT_NONE=y
#BR2_TARGET_ROOTFS_TAR_GZIP=y

# packages on host
# BR2_PACKAGE_HOST_DOSFSTOOLS is not set
# BR2_PACKAGE_HOST_GENIMAGE is not set
# BR2_PACKAGE_HOST_MTOOLS is not set

BR2_TARGET_ROOTFS_TAR_GZIP=y
BR2_PACKAGE_COLLECTD=y
BR2_PACKAGE_COLLECTD_LOGFILE=y
BR2_PACKAGE_COLLECTD_SYSLOG=y
```

## configs/buildroot/arm64_imaevm_defconfig
```kconfig
# Architecture
BR2_aarch64=y

# Toolchain
BR2_TOOLCHAIN=y
BR2_TOOLCHAIN_USES_GLIBC=y
BR2_TOOLCHAIN_EXTERNAL=y
BR2_TOOLCHAIN_EXTERNAL_LINARO_AARCH64=y
BR2_PACKAGE_PROVIDES_TOOLCHAIN_EXTERNAL="toolchain-external-linaro-aarch64"
BR2_TOOLCHAIN_EXTERNAL_PREFIX="aarch64-linux-gnu"

# Download
BR2_DL_DIR="$(HOME)/.buildrootdl"
BR2_ROOTFS_OVERLAY="$(FBOUTDIR)/rfs/rootfs_$(DISTRIB_VERSION)_buildroot_$(DISTROSCALE)_$(DESTARCH)/overlay"

# Hostname and issue
BR2_TARGET_GENERIC_HOSTNAME="lsdk-imaevm"
BR2_TARGET_GENERIC_ISSUE="LSDK initramfs IMA-EVM"

# Target packages
BR2_TARGET_ROOTFS_CPIO=y
BR2_TARGET_ROOTFS_CPIO_GZIP=y
BR2_PACKAGE_KEYUTILS=y
BR2_PACKAGE_UTIL_LINUX=y
BR2_PACKAGE_BUSYBOX_SHOW_OTHERS=y
BR2_PACKAGE_BUSYBOX_CONFIG="package/busybox/busybox.config"
BR2_PACKAGE_BUSYBOX_CONFIG_FRAGMENT_FILES=""

# BR2_INIT_BUSYBOX is not set
BR2_INIT_NONE=y
# BR2_TARGET_ENABLE_ROOT_LOGIN is not set
# BR2_TARGET_GENERIC_GETTY is not set
BR2_PACKAGE_PROVIDES_SKELETON="skeleton-init-none"
BR2_PACKAGE_SKELETON_INIT_NONE=y
#BR2_TARGET_ROOTFS_TAR_GZIP=y

# packages on host
# BR2_PACKAGE_HOST_DOSFSTOOLS is not set
# BR2_PACKAGE_HOST_GENIMAGE is not set
# BR2_PACKAGE_HOST_MTOOLS is not set

BR2_TARGET_ROOTFS_TAR_GZIP=y
BR2_PACKAGE_COLLECTD=y                                                            
BR2_PACKAGE_COLLECTD_LOGFILE=y                                                    
BR2_PACKAGE_COLLECTD_SYSLOG=y                                                     
```
